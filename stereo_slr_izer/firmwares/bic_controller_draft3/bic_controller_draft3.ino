//Beaver Imaging Co. Camera Controller Firmware
//V1.0.0
//Shaurjya Banerjee - 2017

//Written to use SSD1306 128x64 monochrome OLED display from Adafruit with I2C
//Motion control calibrated to use TB6600 Microstep Driver with a 1.8˚/step stepper
//TB6600 set to 2A Microstepping (400 steps/revolution)

//New controller button layout 
//|   B2   |   B1   |
//|   B4   |   B3   |

//Button 1 - Enter/Exit Menu
//Button 2 - Menu Up
//Button 3 - Menu Down 
//Button 4 - Start Routine


//LIBRARIES -----------------------------------------------------------------------
#include <SPI.h>
#include <Wire.h>
#include <Adafruit_GFX.h>
#include <Adafruit_SSD1306.h>
#include <InputDebounce.h>

//THIS SKETCH ---------------------------------------------------------------------
#include "buttons.h"

//SCREEN STUFF --------------------------------------------------------------------

#define OLED_RESET 4
Adafruit_SSD1306 display(OLED_RESET);

// AXIS NAMES
enum Axes {
  X_AXIS = 1,
  P_AXIS = 2,
  T_AXIS = 3
};

//MOTOR CONTROL PINS --------------------------------------------------------------
const byte pul_pin1    = 8;
const byte dir_pin1    = 9;
const byte pul_pin2    = 10;
const byte dir_pin2    = 11;
const byte pul_pin3    = 12;
const byte dir_pin3    = 13;

//MOTOR CONTROL VARIABLES ---------------------------------------------------------
float test_delay = 0.4;
long int test_steps = 24000;
const int pulse_delay = 50; //In microseconds

//GLOBAL POSITIONING VARIABLES ----------------------------------------------------
signed int x_position = 0;
signed int p_position = 0;
signed int t_position = 0;

//LINEAR DISTANCE VARIABLES -------------------------------------------------------
const int steps_per_inch = 1266;  //Number of steps to move one inch linearly
const float inter_focals [] =     //Selection of inter focal distances in inches
{0.5, 1, 2, 2.5, 2.8, 3, 4, 6, 8, 10, 12, 15};
const int max_steps = 18990;      //Maximum travel for 500mm  OpenBuilds C-Beam

//CAMERA CONTROL PINS -------------------------------------------------------------
const byte shutter_pin = 7;

//CONTROLLER PINS -----------------------------------------------------------------
const byte button1_pin = 2;
const byte button2_pin = 3;
const byte button3_pin = 5;
const byte button4_pin = 6;

const byte pot1_pin = A0;
const byte pot2_pin = A1;
const byte pot3_pin = A2;
const byte pot4_pin = A3;

//STATE VARIABLES -----------------------------------------------------------------
static InputDebounce button1;
static InputDebounce button2;
static InputDebounce button3;
static InputDebounce button4;

#define BUTTON_DEBOUNCE_DELAY 20

byte button1_state = 0;
byte button2_state = 0;
byte button3_state = 0;
byte button4_state = 0;

int pot1_val = 0;
int pot2_val = 0;
int pot3_val = 0;
int pot4_val = 0;

byte menu_state           = 0;
byte axis_state           = 1;

//MISC VARIABLES ------------------------------------------------------------------
const byte button_delay = 100;
const int  global_shutter_delay = 1000;
  
#if (SSD1306_LCDHEIGHT != 64)
#error(F("Height incorrect, please fix Adafruit_SSD1306.h!"));
#endif

//BITMAPS -------------------------------------------------------------------------

//Beaver Imaging Co. Logo Image 1
#define SBVR_HEIGHT 128
#define SBVR_GLCD_WIDTH  64 

static const unsigned char PROGMEM sbvr [] = {
0x00, 0x00, 0x00, 0x00, 0x00, 0x00, 0x00, 0x00, 0x00, 0x00, 0x00, 0x00, 0x00, 0x00, 0x00, 0x00, 
0x00, 0x00, 0x00, 0x00, 0x00, 0x00, 0x00, 0x00, 0x00, 0x00, 0x00, 0x00, 0x00, 0x00, 0x00, 0x00, 
0x00, 0x00, 0x00, 0x00, 0x00, 0x00, 0x00, 0x00, 0x00, 0x00, 0x00, 0x00, 0x00, 0x00, 0x00, 0x00, 
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0x00, 0x00, 0x00, 0x00, 0x00, 0x00, 0x00, 0x00, 0x00, 0x00, 0x00, 0x00, 0x00, 0x00, 0x00, 0x00
};

//Beaver Imaging Co. Logo Image 2
#define BBVR_HEIGHT 128
#define BBVR_GLCD_WIDTH  64
static const unsigned char PROGMEM bbvr [] = {
0x00, 0x00, 0x00, 0x00, 0x00, 0x00, 0x00, 0x00, 0x00, 0x00, 0x00, 0x00, 0x00, 0x00, 0x00, 0x00, 
0x00, 0x00, 0x00, 0x00, 0x00, 0x00, 0x00, 0x00, 0x00, 0x00, 0x00, 0x00, 0x00, 0x00, 0x00, 0x00, 
0x00, 0x00, 0x00, 0x00, 0x00, 0x00, 0x00, 0x00, 0x00, 0x00, 0x00, 0x00, 0x00, 0x00, 0x00, 0x00, 
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0x00, 0x00, 0x00, 0x00, 0x00, 0x00, 0x00, 0x00, 0x00, 0x00, 0x00, 0x00, 0x00, 0x00, 0x00, 0x00
};

//SETUP & LOOP --------------------------------------------------------------------

void setup()
{
   //Set pinmode for digital pins
   pinMode(button1_pin, INPUT);
   pinMode(button2_pin, INPUT);
   pinMode(button3_pin, INPUT);
   pinMode(button4_pin, INPUT);

   pinMode(shutter_pin, OUTPUT);
   pinMode(pul_pin1, OUTPUT);
   pinMode(dir_pin1, OUTPUT);
   pinMode(pul_pin2, OUTPUT);
   pinMode(dir_pin2, OUTPUT);
   pinMode(pul_pin3, OUTPUT);
   pinMode(dir_pin3, OUTPUT);

  // debounce Library -------------------------------------------
  // register callback functions (shared, used by all buttons)
  button1.registerCallbacks(buttonTest_pressedCallback, buttonTest_releasedCallback
  , buttonTest_pressedDurationCallback, buttonTest_releasedDurationCallback);
  button2.registerCallbacks(buttonTest_pressedCallback, buttonTest_releasedCallback
  , buttonTest_pressedDurationCallback, buttonTest_releasedDurationCallback);
  button3.registerCallbacks(buttonTest_pressedCallback, buttonTest_releasedCallback
  , buttonTest_pressedDurationCallback, buttonTest_releasedDurationCallback);
  button4.registerCallbacks(buttonTest_pressedCallback, buttonTest_releasedCallback
  , buttonTest_pressedDurationCallback, buttonTest_releasedDurationCallback);

  
  // setup input buttons (debounced)
  button1.setup(button1_pin, BUTTON_DEBOUNCE_DELAY, InputDebounce::PIM_EXT_PULL_DOWN_RES);
  button2.setup(button2_pin, BUTTON_DEBOUNCE_DELAY, InputDebounce::PIM_EXT_PULL_DOWN_RES); // single-shot pressed-on time duration callback
  button3.setup(button3_pin, BUTTON_DEBOUNCE_DELAY, InputDebounce::PIM_EXT_PULL_DOWN_RES);
  button4.setup(button4_pin, BUTTON_DEBOUNCE_DELAY, InputDebounce::PIM_EXT_PULL_DOWN_RES);
  // ------------------------------------------------------------

   //Set default states of digital outs
   digitalWrite(shutter_pin, HIGH);
   
   //Initialization Routine
   Serial.begin(9600);
   display.begin(SSD1306_SWITCHCAPVCC, 0x3D);  // initialize with the I2C addr 0x3D (for the 128x64)

   display.clearDisplay();
   delay(10);

   beaver_flashscreen(5, 100);
   beaver_splashscreen();
}

void loop()
{
  control_poller();
  manual_jog();
  keyframe_loop();
}

//CAMERA CONTROL FUNCTIONS --------------------------------------------------------


//CONTROLLER FUNCTIONS ------------------------------------------------------------
void control_poller()
{
  // poll button state
  unsigned long now = millis();
  button1.process(now); // callbacks called in context of this function
  button2.process(now);
  button3.process(now); // callbacks called in context of this function
  button4.process(now);

  pot1_val = analogRead(pot1_pin);
  pot2_val = analogRead(pot2_pin);
  pot3_val = analogRead(pot3_pin);
  pot4_val = analogRead(pot4_pin);
}


//CUSTOM GFX FUNCTIONS ------------------------------------------------------------

//Flashing Beaver Logo
void beaver_flashscreen(int num_flashes, int dly)
{
  for (int i = 0; i < num_flashes; i++)
  {
    display.drawBitmap(0, 0, sbvr, 128, 64, 1);
    display.display();
    delay(dly);
    display.clearDisplay();
    display.drawBitmap(0, 0, bbvr, 128, 64, 1);
    display.display();
    delay(dly);
    display.clearDisplay();
  }
}

//Stationary Beaver Logo
void beaver_logo()
{
  display.drawBitmap(0, 0, bbvr, 128, 64, 1);
  display.display();
  delay(1500);
  display.clearDisplay();
}

//Text Splashscreen for Beaver Imaging Co.
void beaver_splashscreen()
{
  //BEAVER
  display.setCursor(0,0);
  display.setTextColor(WHITE);
  display.setTextSize(2);
  display.println(F("BEAVER"));
  delay(50);
  display.display();
  //IMAGING
  display.println(F("IMAGING"));
  delay(50);
  display.display();
  //CO.
  display.println("CO.");
  delay(50);
  display.display();

  //Camera Controller Version
  display.setTextSize(1);
  display.setTextColor(WHITE);
  display.println(F("CAMERA CONTROLLER"));
  display.println(F("Version 1.1.0"));
  delay(750);
  display.display();
  delay(100);
  display.clearDisplay();
}

//Function to print the "BUSY" screen
void print_busy()
{
  display.clearDisplay();
  //"Center" the cursor
  display.setCursor(31,22);
  display.setTextColor(WHITE);
  display.setTextSize(3);
  display.println(F("BUSY"));
  display.display();
}


//Function to enable manual control of slider using buttons
void manual_jog()
{
  if (button4_state == HIGH)
  {
    drive_step(0,axis_state);
    
  }

  if (button2_state == HIGH)
  {
    drive_step(1,axis_state);
  }

  //Button to switch axes
  switch (get_button_press(BUTTON_ONE)) {
    case BUTTON_PRESS_SHORT: {

      if (axis_state == 1) {axis_state ++;}
      else if (axis_state == 2) {axis_state --;}
      display.clearDisplay();
      display.setCursor(0,0);
      display.setTextColor(WHITE);
      display.setTextSize(2);
      display.println(F("MOVEMENT"));
      display.println(F("AXIS :"));
      if (axis_state == 1)
      {
        display.println(F("X AXIS"));
        Serial.println(F("X AXIS"));
      }
      else if (axis_state == 2)
      {
        display.println(F("P AXIS"));
        Serial.println(F("P AXIS"));
        display.println(p_position);
      }
      delay(120);
      display.display();

      break;
    }
    case BUTTON_PRESS_LONG: {
      Serial.println("axis switch LONG PRESS");
      break;
    }
    default: {
      break;
    }
  }
  
}

//LOW-LEVEL MOTOR CONTROL FUNCTIONS -----------------------------------------------
//Function to drive stepper motor forward one step
void drive_step(int dir, int axis)
{
  if (axis == X_AXIS)
  {
    if (dir == 0)
    {
      digitalWrite(dir_pin1, LOW);
      digitalWrite(pul_pin1, HIGH);
      delayMicroseconds(pulse_delay);
      digitalWrite(pul_pin1, LOW);
      delayMicroseconds(pulse_delay);
      x_position--;
    }
  
    else if (dir == 1)
    {
      digitalWrite(dir_pin1, HIGH);
      digitalWrite(pul_pin1, HIGH);
      delayMicroseconds(pulse_delay);
      digitalWrite(pul_pin1, LOW);
      delayMicroseconds(pulse_delay);
      x_position++;
    }
  }

  else if (axis == P_AXIS)
  {
    if (dir == 0)
    {
      digitalWrite(dir_pin2, LOW);
      digitalWrite(pul_pin2, HIGH);
      delayMicroseconds(pulse_delay);
      digitalWrite(pul_pin2, LOW);
      delayMicroseconds(pulse_delay);
      p_position--;
    }
  
    else if (dir == 1)
    {
      digitalWrite(dir_pin2, HIGH);
      digitalWrite(pul_pin2, HIGH);
      delayMicroseconds(pulse_delay);
      digitalWrite(pul_pin2, LOW);
      delayMicroseconds(pulse_delay);
      p_position++;
    }    
  }

  else if (axis == T_AXIS)
  {
    if (dir == 0)
    {
      digitalWrite(dir_pin3, LOW);
      digitalWrite(pul_pin3, HIGH);
      delayMicroseconds(pulse_delay);
      digitalWrite(pul_pin3, LOW);
      delayMicroseconds(pulse_delay);
      t_position--;
    }
  
    else if (dir == 1)
    {
      digitalWrite(dir_pin3, HIGH);
      digitalWrite(pul_pin3, HIGH);
      delayMicroseconds(pulse_delay);
      digitalWrite(pul_pin3, LOW);
      delayMicroseconds(pulse_delay);
      t_position++;
    }
  }
}

//Function to move a given number of steps 
//linearly in either direction
//Good value for dly is 350 to 1000
void move_steps(int num_steps, int direct, int dly, int axis)
{
  const int ease_steps = 500;
  int temp_counter = ease_steps;
  
  for (int i = 0; i < num_steps; i++)
  {
    //First lets deal with the ease in
    if (i <= ease_steps)
    {
      drive_step(direct, axis);
      temp_counter--;
      delayMicroseconds(dly+temp_counter);
    }
    //Drive linearly
    else if ( i > ease_steps && i < (num_steps-ease_steps) )
    {
      drive_step(direct, 1);
      delayMicroseconds(dly);
    }
    //Now its time for the Ease out
    else if (i > (num_steps-ease_steps) )
    {
      drive_step(direct, axis);
      temp_counter++;
      delayMicroseconds(dly+temp_counter);
    }
  }
}

//LOW-LEVEL CAMERA CONTROL FUNCTIONS ----------------------------------------------

//Function to take a shot
void take_shot(int sh_delay)
{
  digitalWrite(shutter_pin, LOW);
  delay(sh_delay);
  digitalWrite(shutter_pin, HIGH);
}
