//Screen Menuing System Prototyper
//for Beaver Imaging Co. Camera Controller
//V1.0.0

//Shaurjya Banerjee - 2017

//LIBRARIES -----------------------------------------------------------------------
#include <SPI.h>
#include <Wire.h>
#include <Adafruit_GFX.h>
#include <Adafruit_SSD1306.h>

//SCREEN STUFF --------------------------------------------------------------------

#define OLED_RESET 6
Adafruit_SSD1306 display(OLED_RESET);

#define NUMFLAKES 1
#define XPOS 0
#define YPOS 0
#define DELTAY 0

//MOTOR CONTROL PINS --------------------------------------------------------------


//CAMERA CONTROL PINS -------------------------------------------------------------


//CONTROLLER PINS -----------------------------------------------------------------
int button1_pin = 2;
int button2_pin = 3;
int button3_pin = 4;
int button4_pin = 5;

int pot1_pin = A0;
int pot2_pin = A1;
int pot3_pin = A2;
int pot4_pin = A3;

//STATE VARIABLES -----------------------------------------------------------------
int button1_state = 0;
int button2_state = 0;
int button3_state = 0;
int button4_state = 0;

int pot1_val = 0;
int pot2_val = 0;
int pot3_val = 0;
int pot4_val = 0;

int menu_state = 0;
int enter_state = 0;
int back_state = 0;

//MENU VARIABLES ------------------------------------------------------------------
char* menu_items[] = {
  "NULL",
  "TIME LAPSE CONTROLLER",
  "PANNING TIME LAPSE   ",
  "STEREO PHOTOGRAPHY   ",
  "VIDEO SLIDER         ",
  "MENU5                ",
  "MENU6                "
};

//MISC VARIABLES ------------------------------------------------------------------
int button_delay = 60;
  
#if (SSD1306_LCDHEIGHT != 64)
#error("Height incorrect, please fix Adafruit_SSD1306.h!");
#endif

//BITMAPS -------------------------------------------------------------------------

//Black on White Beaver Logo
#define SBVR_HEIGHT 128
#define SBVR_GLCD_WIDTH  64 
static const unsigned char PROGMEM sbvr [] = {
0xff, 0xff, 0xff, 0xff, 0xff, 0xff, 0xff, 0xff, 0xff, 0xff, 0xff, 0xff, 0xff, 0xff, 0xff, 0xff, 
0xff, 0xff, 0xff, 0xff, 0xff, 0xff, 0xff, 0xff, 0xff, 0xff, 0xff, 0xff, 0xff, 0xff, 0xff, 0xff, 
0xff, 0xff, 0xff, 0xff, 0xff, 0xff, 0xff, 0xff, 0xff, 0xff, 0xff, 0xff, 0xff, 0xff, 0xff, 0xff, 
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0xff, 0xff, 0xff, 0xff, 0xff, 0xff, 0xff, 0xff, 0xff, 0xff, 0xff, 0xff, 0xff, 0xff, 0xff, 0xff
};

//White on black Beaver Logo
#define BBVR_HEIGHT 128
#define BBVR_GLCD_WIDTH  64
static const unsigned char PROGMEM bbvr [] = {
  0x00, 0x00, 0x00, 0x00, 0x00, 0x00, 0x00, 0x00, 0x00, 0x00, 0x00, 0x00, 0x00, 0x00, 0x00, 0x00, 
0x00, 0x00, 0x00, 0x00, 0x00, 0x00, 0x00, 0x00, 0x00, 0x00, 0x00, 0x00, 0x00, 0x00, 0x00, 0x00, 
0x00, 0x00, 0x00, 0x00, 0x00, 0x00, 0x00, 0x00, 0x00, 0x00, 0x00, 0x00, 0x00, 0x00, 0x00, 0x00, 
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0x00, 0x00, 0x00, 0x00, 0x00, 0x00, 0x00, 0x00, 0x00, 0x00, 0x00, 0x00, 0x00, 0x00, 0x00, 0x00
};

//SETUP & LOOP --------------------------------------------------------------------

void setup()
{
   //Set pinmode for controller pins
   pinMode(button1_pin, INPUT);
   pinMode(button2_pin, INPUT);
   pinMode(button3_pin, INPUT);
   pinMode(button4_pin, INPUT);
   
   //Init routine
   Serial.begin(9600);
   display.begin(SSD1306_SWITCHCAPVCC, 0x3D);  // initialize with the I2C addr 0x3D (for the 128x64)

   display.clearDisplay();
   delay(10);

   beaver_logo();
   beaver_splashscreen();
}

void loop()
{
  control_poller();
  control_interpreter();

  if (enter_state != 0)
  {
    display.clearDisplay();
    display_submenu();
  }
  else if (enter_state == 0)
  {
    display.clearDisplay();
    display_menu();
  }
}

//CONTROLLER FUNCTIONS ------------------------------------------------------------
void control_poller()
{
  button1_state = digitalRead(button1_pin);
  button2_state = digitalRead(button2_pin);
  button3_state = digitalRead(button3_pin);
  button4_state = digitalRead(button4_pin);

  pot1_val = analogRead(pot1_pin);
  pot2_val = analogRead(pot2_pin);
  pot3_val = analogRead(pot3_pin);
  pot4_val = analogRead(pot4_pin);
}

//TODO - Make this aware of the size of the menu items array!
void control_interpreter()
{
  //BUTTON 1 - INCREMENTS MENU STATE
  if (button1_state == HIGH)
  {
    //Increment menu state and wrap back
    menu_state ++;
    menu_state = menu_state%7;
    delay(button_delay);
  }
  //BUTTON 2 - DECREMENTS MENU STATE
  if (button2_state == HIGH)
  {
    //Increment menu state and wrap back
    menu_state --;
    if (menu_state == 0) {menu_state = 7;}
    delay(button_delay);
  }
  //BUTTON 3 - ENTER
  if (button3_state == HIGH)
  {
    enter_state = HIGH;
    delay(button_delay);
  }
  //BUTTON 4 - BACK
  if (button4_state == HIGH)
  {
    enter_state = LOW;
    delay(button_delay);
  }
}

//CUSTOM GFX FUNCTIONS ------------------------------------------------------------

//Flashing Beaver Logo
void beaver_flashscreen(int num_flashes, int dly)
{
  for (int i = 0; i < num_flashes; i++)
  {
    display.drawBitmap(0, 0, sbvr, 128, 64, 1);
    display.display();
    delay(dly);
    display.clearDisplay();
    display.drawBitmap(0, 0, bbvr, 128, 64, 1);
    display.display();
    delay(dly);
    display.clearDisplay();
  }
}

//Stationary Beaver Logo
void beaver_logo()
{
  display.drawBitmap(0, 0, bbvr, 128, 64, 1);
  display.display();
  delay(1500);
  display.clearDisplay();
}

//Text Splashscreen for Beaver Imaging Co.
void beaver_splashscreen()
{
  //BEAVER
  display.setCursor(0,0);
  display.setTextColor(WHITE);
  display.setTextSize(2);
  display.println("BEAVER");
  delay(50);
  display.display();
  //IMAGING
  display.println("IMAGING");
  delay(50);
  display.display();
  //CO.
  display.println("CO.");
  delay(50);
  display.display();

  //Camera Controller Version
  display.setTextSize(1);
  display.setTextColor(WHITE);
  display.println("CAMERA CONTROLLER");
  display.println("V1.0.0");
  delay(750);
  display.display();
  delay(1200);
  display.clearDisplay();
}

//Function to display main mode menu
void display_menu()
{
  display.setCursor(0,0);
  display.setTextColor(WHITE);
  display.setTextSize(2);
  display.println("MODE");

  display.setTextSize(1);
  
  //MENU ITEM 1 - 
  display.setTextColor(WHITE);
  if (menu_state == 1) {display.setTextColor(BLACK, WHITE);}
  else if (menu_state != 1) {display.setTextColor(WHITE,BLACK);}
  display.println(menu_items[1]);

  //MENU ITEM 2 - 
  display.setTextColor(WHITE);
  if (menu_state == 2) {display.setTextColor(BLACK, WHITE);}
  else if (menu_state != 2) {display.setTextColor(WHITE,BLACK);}
  display.println(menu_items[2]);

  //MENU ITEM 3 - 
  display.setTextColor(WHITE);
  if (menu_state == 3) {display.setTextColor(BLACK, WHITE);}
  else if (menu_state != 3) {display.setTextColor(WHITE,BLACK);}
  display.println(menu_items[3]);

  //MENU ITEM 4 - 
  display.setTextColor(WHITE);
  if (menu_state == 4) {display.setTextColor(BLACK, WHITE);}
  else if (menu_state != 4) {display.setTextColor(WHITE,BLACK);}
  display.println(menu_items[4]);

  //MENU ITEM 5 - 
  display.setTextColor(WHITE);
  if (menu_state == 5) {display.setTextColor(BLACK, WHITE);}
  else if (menu_state != 5) {display.setTextColor(WHITE,BLACK);}
  display.println(menu_items[5]);

  //MENU ITEM 6 - 
  display.setTextColor(WHITE);
  if (menu_state == 6) {display.setTextColor(BLACK, WHITE);}
  else if (menu_state != 6) {display.setTextColor(WHITE,BLACK);}
  display.println(menu_items[6]);
  
  display.display();
}

//Function to display continuous control values
void display_submenu()
{
  display.clearDisplay();

  display.setCursor(0,0);
  display.setTextColor(WHITE);
  display.setTextSize(2);
  display.println("POT VALUES");
 
  display.setTextSize(1);
  display.println(" ");
  display.print(pot1_val);
  display.println(" ");
  display.print(pot2_val);
  display.println(" ");
  display.print(pot3_val);
  display.println(" ");
  display.print(pot4_val);
  display.println(" ");

  display.display();  

}

//ADAFRUIT GFX UTIL FUNCTIONS -----------------------------------------------------

void testdrawbitmap(const uint8_t *bitmap, uint8_t w, uint8_t h) {
  uint8_t icons[NUMFLAKES][3];
 
  // initialize
  for (uint8_t f=0; f< NUMFLAKES; f++) {
    icons[f][XPOS] = random(display.width());
    icons[f][YPOS] = 0;
    icons[f][DELTAY] = random(5) + 1;
    
    Serial.print("x: ");
    Serial.print(icons[f][XPOS], DEC);
    Serial.print(" y: ");
    Serial.print(icons[f][YPOS], DEC);
    Serial.print(" dy: ");
    Serial.println(icons[f][DELTAY], DEC);
  }

  while (1) {
    // draw each icon
    for (uint8_t f=0; f< NUMFLAKES; f++) {
      display.drawBitmap(icons[f][XPOS], icons[f][YPOS], bitmap, w, h, WHITE);
    }
    display.display();
    delay(200);
    
    // then erase it + move it
    for (uint8_t f=0; f< NUMFLAKES; f++) {
      display.drawBitmap(icons[f][XPOS], icons[f][YPOS], bitmap, w, h, BLACK);
      // move it
      icons[f][YPOS] += icons[f][DELTAY];
      // if its gone, reinit
      if (icons[f][YPOS] > display.height()) {
        icons[f][XPOS] = random(display.width());
        icons[f][YPOS] = 0;
        icons[f][DELTAY] = random(5) + 1;
      }
    }
   }
}


void testdrawchar(void) {
  display.setTextSize(1);
  display.setTextColor(WHITE);
  display.setCursor(0,0);

  for (uint8_t i=0; i < 168; i++) {
    if (i == '\n') continue;
    display.write(i);
    if ((i > 0) && (i % 21 == 0))
      display.println();
  }    
  display.display();
  delay(1);
}

void testdrawcircle(void) {
  for (int16_t i=0; i<display.height(); i+=2) {
    display.drawCircle(display.width()/2, display.height()/2, i, WHITE);
    display.display();
    delay(1);
  }
}

void testfillrect(void) {
  uint8_t color = 1;
  for (int16_t i=0; i<display.height()/2; i+=3) {
    // alternate colors
    display.fillRect(i, i, display.width()-i*2, display.height()-i*2, color%2);
    display.display();
    delay(1);
    color++;
  }
}

void testdrawtriangle(void) {
  for (int16_t i=0; i<min(display.width(),display.height())/2; i+=5) {
    display.drawTriangle(display.width()/2, display.height()/2-i,
                     display.width()/2-i, display.height()/2+i,
                     display.width()/2+i, display.height()/2+i, WHITE);
    display.display();
    delay(1);
  }
}

void testfilltriangle(void) {
  uint8_t color = WHITE;
  for (int16_t i=min(display.width(),display.height())/2; i>0; i-=5) {
    display.fillTriangle(display.width()/2, display.height()/2-i,
                     display.width()/2-i, display.height()/2+i,
                     display.width()/2+i, display.height()/2+i, WHITE);
    if (color == WHITE) color = BLACK;
    else color = WHITE;
    display.display();
    delay(1);
  }
}

void testdrawroundrect(void) {
  for (int16_t i=0; i<display.height()/2-2; i+=2) {
    display.drawRoundRect(i, i, display.width()-2*i, display.height()-2*i, display.height()/4, WHITE);
    display.display();
    delay(1);
  }
}

void testfillroundrect(void) {
  uint8_t color = WHITE;
  for (int16_t i=0; i<display.height()/2-2; i+=2) {
    display.fillRoundRect(i, i, display.width()-2*i, display.height()-2*i, display.height()/4, color);
    if (color == WHITE) color = BLACK;
    else color = WHITE;
    display.display();
    delay(1);
  }
}
   
void testdrawrect(void) {
  for (int16_t i=0; i<display.height()/2; i+=2) {
    display.drawRect(i, i, display.width()-2*i, display.height()-2*i, WHITE);
    display.display();
    delay(1);
  }
}

void testdrawline() {  
  for (int16_t i=0; i<display.width(); i+=4) {
    display.drawLine(0, 0, i, display.height()-1, WHITE);
    display.display();
    delay(1);
  }
  for (int16_t i=0; i<display.height(); i+=4) {
    display.drawLine(0, 0, display.width()-1, i, WHITE);
    display.display();
    delay(1);
  }
  delay(250);
  
  display.clearDisplay();
  for (int16_t i=0; i<display.width(); i+=4) {
    display.drawLine(0, display.height()-1, i, 0, WHITE);
    display.display();
    delay(1);
  }
  for (int16_t i=display.height()-1; i>=0; i-=4) {
    display.drawLine(0, display.height()-1, display.width()-1, i, WHITE);
    display.display();
    delay(1);
  }
  delay(250);
  
  display.clearDisplay();
  for (int16_t i=display.width()-1; i>=0; i-=4) {
    display.drawLine(display.width()-1, display.height()-1, i, 0, WHITE);
    display.display();
    delay(1);
  }
  for (int16_t i=display.height()-1; i>=0; i-=4) {
    display.drawLine(display.width()-1, display.height()-1, 0, i, WHITE);
    display.display();
    delay(1);
  }
  delay(250);

  display.clearDisplay();
  for (int16_t i=0; i<display.height(); i+=4) {
    display.drawLine(display.width()-1, 0, 0, i, WHITE);
    display.display();
    delay(1);
  }
  for (int16_t i=0; i<display.width(); i+=4) {
    display.drawLine(display.width()-1, 0, i, display.height()-1, WHITE); 
    display.display();
    delay(1);
  }
  delay(250);
}

void testscrolltext(void) {
  display.setTextSize(2);
  display.setTextColor(WHITE);
  display.setCursor(10,0);
  display.clearDisplay();
  display.println("scroll");
  display.display();
  delay(1);
 
  display.startscrollright(0x00, 0x0F);
  delay(2000);
  display.stopscroll();
  delay(1000);
  display.startscrollleft(0x00, 0x0F);
  delay(2000);
  display.stopscroll();
  delay(1000);    
  display.startscrolldiagright(0x00, 0x07);
  delay(2000);
  display.startscrolldiagleft(0x00, 0x07);
  delay(2000);
  display.stopscroll();
}
